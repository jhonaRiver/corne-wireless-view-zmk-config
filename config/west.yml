## config/west.yml
```yaml
manifest:
  remotes:
    - name: zmkfirmware
      url-base: https://github.com/zmkfirmware
    - name: urob
      url-base: https://github.com/urob
    - name: caksoylar
      url-base: https://github.com/caksoylar

  projects:
    - name: zmk
      remote: zmkfirmware
      import: app/west.yml
      revision: abb64ba316c29caddc49727ca2cac2f0ed5970c7  # Last commit before Zephyr 4.1 upgrade

    - name: zmk-auto-layer
      remote: urob
      revision: main

    - name: zmk-tri-state
      remote: urob
      revision: main

  self:
    path: config
```
