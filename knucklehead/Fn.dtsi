/**
 * Function / System Layer
 */

/ {
  keymap {
    fn_layer {
      display-name = "Fn";
      bindings = <
        &trans  &kp F1  &kp F2  &kp F3  &kp F4  &kp F5  &trans  &trans  &trans  &trans  &trans  &trans
        &trans  &kp F6  &hrml LCTRL F7  &hrml LALT F8  &hrml LCMD F9  &hrml MEH F10  &trans  &trans  &trans  &trans  &trans  &trans
        &trans  &kp F11  &kp F12  &kp F13  &kp F14  &kp F15  &trans  &trans  &trans  &trans  &trans  &trans
        &cmo Fn  &cmo L2  &trans  &trans  &kp CAPSLOCK  &trans
      >;
    };
  };
};
